## config/boards/shields/split44/Kconfig.defconfig
```kconfig
if SHIELD_SPLIT44_LEFT

config ZMK_KEYBOARD_NAME
    default "Split44"

endif


if SHIELD_SPLIT44_LEFT || SHIELD_SPLIT44_RIGHT

config ZMK_SPLIT
    default y

endif
```

## config/boards/shields/split44/Kconfig.shield
```kconfig
config SHIELD_SPLIT44_LEFT
    def_bool $(shields_list_contains, split44_left)

config SHIELD_SPLIT44_RIGHT
    def_bool $(shields_list_contains, split44_right)
```
